## firmware/player/sdkconfig.defaults
```kconfig
CONFIG_I2C_ENABLE_SLAVE_DRIVER_VERSION_2=y

# ── Bluetooth / NimBLE ────────────────────────────────────────────────────────
# ESP32-C6 uses NimBLE exclusively (no Bluedroid).
CONFIG_BT_ENABLED=y
CONFIG_BT_NIMBLE_ENABLED=y

# Only need peripheral (GATT server) role.
CONFIG_BT_NIMBLE_ROLE_CENTRAL=n
CONFIG_BT_NIMBLE_ROLE_OBSERVER=n
CONFIG_BT_NIMBLE_ROLE_BROADCASTER=n
CONFIG_BT_NIMBLE_ROLE_PERIPHERAL=y

# One simultaneous connection is sufficient.
CONFIG_BT_NIMBLE_MAX_CONNECTIONS=1

# NVS is required by NimBLE for bond/IRK storage.
CONFIG_NVS_ENABLED=y
```
